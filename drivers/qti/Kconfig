## drivers/qti/Kconfig
```kconfig
source "drivers/qti/mhi/Kconfig"
source "drivers/qti/qrtr/Kconfig"
source "drivers/qti/rmnet_data/Kconfig"
source "drivers/qti/rmnet_usb/Kconfig"
source "drivers/qti/usb_bridge/Kconfig"
source "drivers/qti/diag/Kconfig"
source "drivers/qti/usb_diag/Kconfig"
source "drivers/qti/qmi/Kconfig"
```

## drivers/qti/diag/Kconfig
```kconfig
menu "Diag Support"

config QTI_DIAG_CHAR
	tristate "DIAG CHAR Interface Core"
	default n
	depends on QTI_USB_F_DIAG
	select CRC_CCITT
	help
	  Char driver interface for SoC Diagnostic information. The DIAG Char
	  driver provides diag forwarding to user space and SoC Peripherals.
	  This enables diagchar for maemo usb gadget or android usb gadget
	  based on config selected.

config QTI_DIAG_OVER_USB
	bool "Enable DIAG traffic to go over USB"
	depends on QTI_DIAG_CHAR
	default y
	help
	  Diag over USB enables sending DIAG traffic over a USB transport. When
	  the USB endpoints become available, the DIAG driver will enable Diag
	  traffic over USB. This allows for host side tools to parse and display
	  Diag traffic from the USB endpoint.

config QTI_DIAGFWD_BRIDGE_CODE
	bool "Enable remote DIAG traffic over MHI/HSIC"
	depends on QTI_DIAG_CHAR
	depends on QTI_USB_DIAG_BRIDGE || QTI_MHI_BUS
	default y
	help
	  MHI/HSIC Transport Layer for DIAG Router. When the MHI/HSIC endpoints
	  become available, this bridge driver enables DIAG traffic over MHI
	  and HSIC.

config QTI_DIAG_OVER_PCIE
	bool "Enable Diag traffic to go over PCIE"
	depends on QTI_DIAG_CHAR
	depends on QTI_MSM_MHI_DEV
	help
	  Diag over PCIE enables sending diag traffic over PCIE endpoint when
	  pcie is available. Diag PCIE channels should be configured
	  and connected to use the transport. If PCIE is not configured
	  diag will switch to usb mode and diag traffic will be routed
	  over USB.

endmenu
```

## drivers/qti/mhi/Kconfig
```kconfig
config QTI_MHI_BUS
	tristate "Modem Host Interface"
	help
	  MHI Host Interface is a communication protocol to be used by the host
	  to control and communcate with modem over a high speed peripheral bus.
	  Enabling this module will allow host to communicate with external
	  devices that support MHI protocol.

config QTI_MHI_DEBUG
	bool "MHI debug support"
	depends on QTI_MHI_BUS
	help
	  Say yes here to enable debugging support in the MHI transport
	  and individual MHI client drivers. This option will impact
	  throughput as individual MHI packets and state transitions
	  will be logged.

source drivers/qti/mhi/controllers/Kconfig
source drivers/qti/mhi/devices/Kconfig
```

## drivers/qti/mhi/controllers/Kconfig
```kconfig
menu "MHI controllers"

config QTI_MHI_QCOM
       tristate "MHI QCOM"
       depends on QTI_MHI_BUS && PCI
       help
	  If you say yes to this option, MHI bus support for QCOM modem chipsets
	  will be enabled.

endmenu
```

## drivers/qti/mhi/devices/Kconfig
```kconfig
menu "MHI device support"

config QTI_MHI_NETDEV
       tristate "MHI NETDEV"
       depends on QTI_MHI_BUS && QTI_RMNET_DATA
       help
	  MHI based net device driver for transferring IP traffic
	  between host and modem. By enabling this driver, clients
	  can transfer data using standard network interface.

config QTI_MHI_UCI
       tristate "MHI UCI"
       depends on QTI_MHI_BUS
       help
	  MHI based uci driver is for transferring data between host and
	  modem using standard file operations from user space. Open, read,
	  write, ioctl, and close operations are supported by this driver.

endmenu
```

## drivers/qti/qmi/Kconfig
```kconfig
config QTI_QMI_HELPERS
	bool "QTI QMI Helpers"
	depends on QTI_QRTR
	select QMI_HELPERS
	help
          Helper library for handling QMI encoded messages.  QMI encoded
          messages are used in communication between the majority of QRTR
          clients and this helpers provide the common functionality needed for
          doing this from a kernel driver.

config QMI_HELPERS
	bool
	help
	  Drivers which using QMI service/client should use this config. This is
	  added to support QMI helper library from both msm kernel and EAP. QMI
	  encoded messages are used in communication between QRTR clients.
	  QTI_QMI_HELPERS will select this config.
```

## drivers/qti/qrtr/Kconfig
```kconfig
# Qualcomm IPC Router configuration
#

config QTI_QRTR
	tristate "Qualcomm IPC Router support"
	---help---
	  Say Y if you intend to use Qualcomm IPC router protocol.  The
	  protocol is used to communicate with services provided by other
	  hardware blocks in the system.

	  In order to do service lookups, a userspace daemon is required to
	  maintain a service listing.

if QTI_QRTR

config QTI_QRTR_MHI
	tristate "MHI IPC Router channels"
	depends on QTI_MHI_BUS || (COMPILE_TEST && QTI_MHI_BUS=n)
	---help---
	  Say Y here to support MHI based ipcrouter channels.  MHI is the
	  transport used for external modem connections for IPC Router.

config QTI_QRTR_USB
	tristate "USB IPC Router channels"
	depends on USB || (COMPILE_TEST && USB=n)
	---help---
	  Say Y here to support USB based ipcrouter channels.

endif # QRTR_QTI
```

## drivers/qti/usb_bridge/Kconfig
```kconfig
config QTI_USB_F_BRIDGE
       tristate

config QTI_USB_BRIDGE
	tristate "Host port device port bridge support"
	depends on USB
	depends on USB_LIBCOMPOSITE
	select QTI_USB_F_BRIDGE
	help
	  The driver is for bridging bulk endpoints between USB host port
	  and USB device port. The interfaces to be bridged should be enabled
	  using CONFIGFS, this driver will claim those interfaces from the host
	  port and bridge them as CONFIGFS functions on the device port.
	  Say Y here if you want the device to act as a USB bridge between
	  a USB host and a USB device. If unsure, choose N.
```

## drivers/qti/usb_diag/Kconfig
```kconfig
config QTI_USB_F_DIAG
	bool "USB diag function"
	depends on USB_LIBCOMPOSITE
	help
	  Diag function driver enables support for QTI diagnostics
	  port over USB.

config QTI_USB_DIAG_BRIDGE
	tristate "USB QTI diagnostic bridge driver"
	depends on USB
	help
	  This driver communicates with the diagnostic interface and
	  allows for bridging with the diag forwarding driver.
```
